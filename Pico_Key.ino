#include <SPI.h>
#include <Wire.h>
#include <Adafruit_GFX.h>
#include <Adafruit_SSD1306.h>
#include <AiEsp32RotaryEncoder.h>
#include <EEPROM.h>
#include "BleKeyboard.h"
#include "Switch.h"
#include "Menu.h"

#define EEPROM_SIZE 512 // Adjust the size as needed

// Define keyboard scale
#define X_KEY 3
#define Y_KEY 3

// Define Row and Column Pin
#define COL_1 14
#define COL_2 18
#define COL_3 19
#define ROW_1 23
#define ROW_2 25
#define ROW_3 27

// Define Encoder Pin
#define ROTARY_ENCODER_BUTTON_PIN 13
#define ROTARY_ENCODER_A_PIN  32
#define ROTARY_ENCODER_B_PIN 33
#define ROTARY_ENCODER_VCC_PIN -1
#define ROTARY_ENCODER_STEPS 4

// Define RGB Pin
#define LED_RED 26
#define LED_GREEN 17
#define LED_BLUE 18

// Define Display configuration
#define SCREEN_ADDRESS 0x3C
#define SCREEN_WIDTH 128
#define SCREEN_HEIGHT 64
#define OLED_RESET -1
Adafruit_SSD1306 display(SCREEN_WIDTH, SCREEN_HEIGHT, &Wire, OLED_RESET);

// Define Rotary Encoder Configuration
AiEsp32RotaryEncoder rotaryEncoder = AiEsp32RotaryEncoder(ROTARY_ENCODER_A_PIN, ROTARY_ENCODER_B_PIN, ROTARY_ENCODER_BUTTON_PIN, ROTARY_ENCODER_VCC_PIN, ROTARY_ENCODER_STEPS);

// Define Default Switch key
byte sw_1_key = KEY_LEFT_ARROW;
byte sw_2_key = KEY_UP_ARROW;
byte sw_3_key = '[';
byte sw_4_key = KEY_DOWN_ARROW;
byte sw_5_key = KEY_RIGHT_ARROW;
byte sw_6_key = ']';
byte sw_7_key = '/';
byte sw_8_key = ';';
byte sw_9_key = ',';

Switch sw_1(sw_1_key, ROW_1, COL_1);
Switch sw_2(sw_2_key, ROW_1, COL_2);
Switch sw_3(sw_3_key, ROW_1, COL_3);
Switch sw_4(sw_4_key, ROW_2, COL_1);
Switch sw_5(sw_5_key, ROW_2, COL_2);
Switch sw_6(sw_6_key, ROW_2, COL_3);
Switch sw_7(sw_7_key, ROW_3, COL_1);
Switch sw_8(sw_8_key, ROW_3, COL_2);
Switch sw_9(sw_9_key, ROW_3, COL_3);

// Defin Bitmaps
// 'scroll-position_0', 128x64px
const unsigned char epd_bitmap_scroll_position_0 [] PROGMEM = {
	0x00, 0x00, 0x00, 0x00, 0x00, 0x00, 0x00, 0x00, 0x00, 0x00, 0x00, 0x00, 0x00, 0x00, 0x00, 0x00, 
	0x00, 0x00, 0x00, 0x00, 0x00, 0x00, 0x00, 0x00, 0x00, 0x00, 0x00, 0x00, 0x00, 0x00, 0x00, 0x00, 
	0x00, 0x00, 0x00, 0x00, 0x00, 0x00, 0x00, 0x00, 0x00, 0x00, 0x00, 0x00, 0x00, 0x00, 0x00, 0x00, 
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	0x00, 0x00, 0x00, 0x00, 0x00, 0x00, 0x00, 0x00, 0x00, 0x00, 0x00, 0x00, 0x00, 0x00, 0x00, 0x00
};
// 'scroll-position_1', 128x64px
const unsigned char epd_bitmap_scroll_position_1 [] PROGMEM = {
	0x00, 0x00, 0x00, 0x00, 0x00, 0x00, 0x00, 0x00, 0x00, 0x00, 0x00, 0x00, 0x00, 0x00, 0x00, 0x00, 
	0x00, 0x00, 0x00, 0x00, 0x00, 0x00, 0x00, 0x00, 0x00, 0x00, 0x00, 0x00, 0x00, 0x00, 0x00, 0x00, 
	0x00, 0x00, 0x00, 0x00, 0x00, 0x00, 0x00, 0x00, 0x00, 0x00, 0x00, 0x00, 0x00, 0x00, 0x00, 0x00, 
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	0x00, 0x00, 0x00, 0x00, 0x00, 0x00, 0x00, 0x00, 0x00, 0x00, 0x00, 0x00, 0x00, 0x00, 0x00, 0x00
};
// 'scroll-position_2', 128x64px
const unsigned char epd_bitmap_scroll_position_2 [] PROGMEM = {
	0x00, 0x00, 0x00, 0x00, 0x00, 0x00, 0x00, 0x00, 0x00, 0x00, 0x00, 0x00, 0x00, 0x00, 0x00, 0x00, 
	0x00, 0x00, 0x00, 0x00, 0x00, 0x00, 0x00, 0x00, 0x00, 0x00, 0x00, 0x00, 0x00, 0x00, 0x00, 0x00, 
	0x00, 0x00, 0x00, 0x00, 0x00, 0x00, 0x00, 0x00, 0x00, 0x00, 0x00, 0x00, 0x00, 0x00, 0x00, 0x00, 
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	0x00, 0x00, 0x00, 0x00, 0x00, 0x00, 0x00, 0x00, 0x00, 0x00, 0x00, 0x00, 0x00, 0x00, 0x00, 0x00
};

const unsigned char* epd_card_allArray[3] = {
	epd_bitmap_scroll_position_0,
	epd_bitmap_scroll_position_1,
	epd_bitmap_scroll_position_2
};

// 'keyboard_icon', 16x16px
const unsigned char epd_bitmap_keyboard_icon [] PROGMEM = {
	0x00, 0x04, 0x07, 0x18, 0x0c, 0xf0, 0x08, 0x00, 0xff, 0x80, 0x80, 0x80, 0xb0, 0x80, 0xb0, 0x80, 
	0x80, 0x80, 0xaa, 0x80, 0x80, 0x80, 0xaa, 0x80, 0x80, 0x80, 0xaa, 0x80, 0x80, 0x80, 0xff, 0x80
};
// 'mini-game_icon', 16x16px
const unsigned char epd_bitmap_mini_game_icon [] PROGMEM = {
	0x0f, 0x0f, 0x0f, 0x0f, 0x0f, 0x0f, 0x0f, 0x0f, 0xf0, 0xf0, 0xf0, 0xf0, 0xf0, 0xf0, 0xf0, 0xf0, 
	0x0f, 0x0f, 0x0f, 0x0f, 0x0f, 0x0f, 0x0f, 0x0f, 0xf0, 0xf0, 0xf0, 0xf0, 0xf0, 0xf0, 0xf0, 0xf0
};
// 'setting_icon', 16x16px
const unsigned char epd_bitmap_setting_icon [] PROGMEM = {
	0x19, 0x98, 0x26, 0x64, 0x79, 0x9e, 0xa6, 0x65, 0xa9, 0x95, 0x56, 0x6a, 0x55, 0xaa, 0xaa, 0x55, 
	0xaa, 0x55, 0x55, 0xaa, 0x56, 0x6a, 0xa9, 0x95, 0xa6, 0x65, 0x79, 0x9e, 0x26, 0x64, 0x19, 0x98
};

const unsigned char* epd_icon_allArray[3] = {
	epd_bitmap_keyboard_icon,
	epd_bitmap_mini_game_icon,
	epd_bitmap_setting_icon
};

// Row Active States
byte rowActv[3] = {1, 0, 0};
int iteration = 0;

// Rotary Encoder States
int prevEncVal = 0;

// Menu States
int selectedMenu = -1;

// Array of all bitmaps for convenience. (Total bytes used to store images in PROGMEM = 144)
int max_menu_screen = 3;
int menu_LEN = 3;
int menuOrder[3] = {2, 0, 1}; // "Mini Games", "Keyboard", "Setting"
String menus[3] = {"Keyboard", "Mini Games", "Setting"};
Menu menu(menus);

// Games States
int selectedGame = -1;
int Game_LEN = 3;
int gameOrder[3] = {2, 0, 1};
String listGames[3] = {"Flappy Bird", "Snake", ""};
Menu games(listGames);

// Games States
int selectedSetting = -1;
int Setting_LEN = 3;
int settingOrder[3] = {2, 0, 1};
String listSetting[3] = {"Macro Key", "Game Key", "Help"};
Menu settings(listSetting);

BleKeyboard bleKeyboard("Pico_key", "BLough", 100);

void initKeyboardKey() {
  sw_1_key = EEPROM.read(0) ? EEPROM.read(0) : sw_1_key;
  sw_2_key = EEPROM.read(1) ? EEPROM.read(1) : sw_2_key;
  sw_3_key = EEPROM.read(2) ? EEPROM.read(2) : sw_3_key;
  sw_4_key = EEPROM.read(3) ? EEPROM.read(3) : sw_4_key;
  sw_5_key = EEPROM.read(4) ? EEPROM.read(4) : sw_5_key;
  sw_6_key = EEPROM.read(5) ? EEPROM.read(5) : sw_6_key;
  sw_7_key = EEPROM.read(6) ? EEPROM.read(6) : sw_7_key;
  sw_8_key = EEPROM.read(7) ? EEPROM.read(7) : sw_8_key;
  sw_9_key = EEPROM.read(8) ? EEPROM.read(8) : sw_9_key;
}

void printToOled8t(uint8_t text, int size = 3) {
  display.clearDisplay(); // Clear display buffer
  display.setTextSize(size); // Draw 2X-scale text
  display.setTextColor(SSD1306_WHITE);
  display.setCursor(55, 25);
  display.print(String(text));
  display.display();
}

void printToOled(String text, int size = 3) {
  display.clearDisplay(); // Clear display buffer
  display.setTextSize(size); // Draw 2X-scale text
  display.setTextColor(SSD1306_WHITE);
  display.setCursor(55, 25);
  display.print(String(text));
  display.display();
}

int waitCount = 0;

void waitDisplay() {
  display.setTextSize(1); // Draw 2X-scale text
  display.setTextColor(SSD1306_WHITE);
  display.setCursor(30, 25);
  display.print("Waiting");

  for(int k = 0; k < waitCount; k++) {
    display.setCursor(75+k*4, 25);
    display.setTextSize(1); // Draw 2X-scale text
    display.setTextColor(SSD1306_WHITE);
    display.print(".");
    display.display();
    delay(10);
  }

  if(waitCount>=3) {
    waitCount = 0;
    display.clearDisplay();
  } else {
    waitCount++;
  }
}

void shiftMenu(int num) {
  // if num = 0: shift menu to left
  // if num = 1: shift menu to right
  if(num == 1) {
    // int lastEl = menuOrder[menu_LEN-1];
    for(int i = 0; i < menu_LEN-1; i++) {
      int lastIdx = menu_LEN-1;
      int temp = menuOrder[lastIdx-i];
      menuOrder[lastIdx-i] = menuOrder[lastIdx-(i+1)];
      menuOrder[lastIdx-(i+1)] = temp;
    }
  } else {
    // int firstEl = menuOrder[menu_LEN-1];
    for(int i = 0; i < menu_LEN-1; i++) {
      int temp = menuOrder[i];
      menuOrder[i] = menuOrder[i+1];
      menuOrder[i+1] = temp;
    }
  }
}

void shiftListGame(int num) {
  // if num = 0: shift menu to left
  // if num = 1: shift menu to right
  if(num == 1) {
    // int lastEl = gameOrder[menu_LEN-1];
    for(int i = 0; i < menu_LEN-1; i++) {
      int lastIdx = menu_LEN-1;
      int temp = gameOrder[lastIdx-i];
      gameOrder[lastIdx-i] = gameOrder[lastIdx-(i+1)];
      gameOrder[lastIdx-(i+1)] = temp;
    }
  } else {
    // int firstEl = gameOrder[menu_LEN-1];
    for(int i = 0; i < menu_LEN-1; i++) {
      int temp = gameOrder[i];
      gameOrder[i] = gameOrder[i+1];
      gameOrder[i+1] = temp;
    }
  }
}

void shiftListSetting(int num) {
  // if num = 0: shift menu to left
  // if num = 1: shift menu to right
  if(num == 1) {
    // int lastEl = gameOrder[menu_LEN-1];
    for(int i = 0; i < menu_LEN-1; i++) {
      int lastIdx = menu_LEN-1;
      int temp = settingOrder[lastIdx-i];
      settingOrder[lastIdx-i] = settingOrder[lastIdx-(i+1)];
      settingOrder[lastIdx-(i+1)] = temp;
    }
  } else {
    // int firstEl = gameOrder[menu_LEN-1];
    for(int i = 0; i < menu_LEN-1; i++) {
      int temp = settingOrder[i];
      settingOrder[i] = settingOrder[i+1];
      settingOrder[i+1] = temp;
    }
  }
}

void updateMenuDisplay() {
  display.clearDisplay();

  for(int i = 0; i < max_menu_screen; i++) {
    int posY;
    if(i==0) posY = ((i*16) + 2*(i+1));
    else posY = ((i*16) + 4*(i+1));
    display.drawBitmap( 10, posY, epd_icon_allArray[menuOrder[i]], 16, 16, 1);
    display.setTextSize(1);
    display.setTextColor(WHITE);
    display.setCursor(30, posY+4);
    display.println(menu.getMenuText(menuOrder[i]));
  }

  display.drawBitmap( 0, 0, epd_card_allArray[menu.getFocusMenu()], 128, 64, 1);
  display.display();
  delay(1);
}

void updateGameMenuDisplay() {
  display.clearDisplay();

  for(int i = 0; i < max_menu_screen; i++) {
    int posY;
    if(i==0) posY = ((i*16) + 2*(i+1));
    else posY = ((i*16) + 4*(i+1));
    display.setTextSize(1);
    display.setTextColor(WHITE);
    display.setCursor(30, posY+4);
    display.println(games.getMenuText(gameOrder[i]));
  }

  display.drawBitmap( 0, 0, epd_card_allArray[games.getFocusMenu()], 128, 64, 1);
  display.display();
  delay(1);
}

void updateSettingMenuDisplay() {
  display.clearDisplay();

  for(int i = 0; i < max_menu_screen; i++) {
    int posY;
    if(i==0) posY = ((i*16) + 2*(i+1));
    else posY = ((i*16) + 4*(i+1));
    display.setTextSize(1);
    display.setTextColor(WHITE);
    display.setCursor(30, posY+4);
    display.println(settings.getMenuText(settingOrder[i]));
  }

  display.drawBitmap( 0, 0, epd_card_allArray[settings.getFocusMenu()], 128, 64, 1);
  display.display();
  delay(1);
}

void handleRunningRow() {
  // Update Row active state
  for(int i = 0; i < X_KEY; i++) {
    if (i == iteration) {
      rowActv[i] = 1;
    } else {
      rowActv[i] = 0;
    }
  }

  // Write Digital Row Pin according to rowState
  digitalWrite(ROW_1, LOW);
  digitalWrite(ROW_2, LOW);
  digitalWrite(ROW_3, LOW);
  if(rowActv[0]) {
    digitalWrite(ROW_1, HIGH);
  } else if(rowActv[1]) {
    digitalWrite(ROW_2, HIGH);
  } else if(rowActv[2]) {
    digitalWrite(ROW_3, HIGH);
  }

  if(iteration >= X_KEY - 1) {
    iteration = 0;
  } else {
    iteration++;
  }
}

bool keyStates[9] = {false, false, false, false, false, false, false, false, false};

void writeKeyboard(uint8_t key) {
  printToOled8t(key);
  bleKeyboard.write(key);
}
void pressKeyboard(uint8_t key, int idx) {
  printToOled8t(key);

  if(!keyStates[idx]) {
    keyStates[idx] = true;
    bleKeyboard.press(key);
  }
}

void watchKeySwitch() {
  handleRunningRow();

  if(rowActv[0]) {
    if(sw_1.isPressed()) {
      Serial.println("pressed");
      pressKeyboard(sw_1.getKey(), 0);
    } else if(keyStates[0]) {
      bleKeyboard.release(sw_1.getKey());
      keyStates[0] = false;
    }
    
    if(sw_2.isPressed()) {
      Serial.println("pressed");
      pressKeyboard(sw_2.getKey(), 1);
    } else if(keyStates[1]) {
      bleKeyboard.release(sw_2.getKey());
      keyStates[1] = false;
    }

    if(sw_3.isPressed()) {
      Serial.println("pressed");
      pressKeyboard(sw_3.getKey(), 2);
    } else if(keyStates[2]) {
      bleKeyboard.release(sw_3.getKey());
      keyStates[2] = false;
    }
  } else if(rowActv[1]) {
    if(sw_4.isPressed()) {
      Serial.println("pressed");
      pressKeyboard(sw_4.getKey(), 3);
    } else if(keyStates[3]) {
      bleKeyboard.release(sw_4.getKey());
      keyStates[3] = false;
    }

    if(sw_5.isPressed()) {
      Serial.println("pressed");
      pressKeyboard(sw_5.getKey(), 4);
    } else if(keyStates[4]) {
      bleKeyboard.release(sw_5.getKey());
      keyStates[4] = false;
    }

    if(sw_6.isPressed()) {
      Serial.println("pressed");
      pressKeyboard(sw_6.getKey(), 5);
    } else if(keyStates[5]) {
      bleKeyboard.release(sw_6.getKey());
      keyStates[5] = false;
    }
  } else if(rowActv[2]) {
    if(sw_7.isPressed()) {
      Serial.println("pressed");
      pressKeyboard(sw_7.getKey(), 6);
    } else if(keyStates[6]) {
      bleKeyboard.release(sw_7.getKey());
      keyStates[6] = false;
    }

    if(sw_8.isPressed()) {
      Serial.println("pressed");
      pressKeyboard(sw_8.getKey(), 7);
    } else if(keyStates[7]) {
      bleKeyboard.release(sw_8.getKey());
      keyStates[7] = false;
    }

    if(sw_9.isPressed()) {
      Serial.println("pressed");
      pressKeyboard(sw_9.getKey(), 8);
    } else if(keyStates[8]) {
      bleKeyboard.release(sw_9.getKey());
      keyStates[8] = false;
    }
  }

  delay(4); // 12 debounced delay / 3 column
}

void rotary_onButtonClick() {
    static unsigned long lastTimePressed = 0; // Soft debouncing
    if (millis() - lastTimePressed < 500)
    {
            return;
    }
    if(selectedMenu == -1) {
      menu.selectMenu();
    } else if(selectedMenu == 1){
      games.selectMenu();
      delay(10);
      selectedGame = games.getSelectedMenu();
    } else if(selectedMenu == 2){
      settings.selectMenu();
      delay(10);
      selectedSetting = settings.getSelectedMenu();
    } else {
      menu.openMenu();
    }
    
    selectedMenu = menu.getSelectedMenu();
}

void watchRotary() {
  if(selectedMenu == -1) {
    if (rotaryEncoder.encoderChanged()) {
      if(rotaryEncoder.readEncoder() > prevEncVal) {
        menu.next();
        shiftMenu(0);
        updateMenuDisplay();
      } else if (rotaryEncoder.readEncoder() <= prevEncVal) {
        menu.prev();
        shiftMenu(1);
        updateMenuDisplay();
      }
      
      if(rotaryEncoder.readEncoder() == 0) {
        rotaryEncoder.setEncoderValue(250);
      }

      prevEncVal = rotaryEncoder.readEncoder();
    }
    if (rotaryEncoder.isEncoderButtonClicked()) {
      rotary_onButtonClick();
    }
  } else if (selectedMenu == 0) {
    if (rotaryEncoder.encoderChanged()) {
      if (rotaryEncoder.readEncoder() > prevEncVal) {
        bleKeyboard.write(KEY_MEDIA_VOLUME_UP);
      } else {
        bleKeyboard.write(KEY_MEDIA_VOLUME_DOWN);
      }
      
      if(rotaryEncoder.readEncoder() == 0) {
        rotaryEncoder.setEncoderValue(250);
      }

      prevEncVal = rotaryEncoder.readEncoder();
    }
    if (rotaryEncoder.isEncoderButtonClicked()) {
      bleKeyboard.end();
      rotary_onButtonClick();
    }
  } else if (selectedMenu == 1) {
    if (rotaryEncoder.encoderChanged()) {
      if(rotaryEncoder.readEncoder() > prevEncVal) {
        games.next();
        shiftListGame(0);
        updateGameMenuDisplay();
      } else if (rotaryEncoder.readEncoder() <= prevEncVal) {
        games.prev();
        shiftListGame(1);
        updateGameMenuDisplay();
      }
      
      if(rotaryEncoder.readEncoder() == 0) {
        rotaryEncoder.setEncoderValue(250);
      }

      prevEncVal = rotaryEncoder.readEncoder();
    }
    if (rotaryEncoder.isEncoderButtonClicked()) {
      rotary_onButtonClick();
    }
  } else if (selectedMenu == 2) {
    if (rotaryEncoder.encoderChanged()) {
      if(rotaryEncoder.readEncoder() > prevEncVal) {
        settings.next();
        shiftListSetting(0);
        updateSettingMenuDisplay();
      } else if (rotaryEncoder.readEncoder() <= prevEncVal) {
        settings.prev();
        shiftListSetting(1);
        updateSettingMenuDisplay();
      }
      
      if(rotaryEncoder.readEncoder() == 0) {
        rotaryEncoder.setEncoderValue(250);
      }

      prevEncVal = rotaryEncoder.readEncoder();
    }
    if (rotaryEncoder.isEncoderButtonClicked()) {
      rotary_onButtonClick();
    }
  }
}

void IRAM_ATTR readEncoderISR() {
    rotaryEncoder.readEncoder_ISR();
}

// This will hold down all the following buttons.
void sendMacroCommand(uint8_t key) {
  bleKeyboard.press(KEY_LEFT_CTRL);
  bleKeyboard.press(KEY_LEFT_SHIFT);
  bleKeyboard.press(KEY_LEFT_ALT);
  bleKeyboard.press(key);
}

void setup() {
  EEPROM.begin(EEPROM_SIZE);

  // PinIO Configurations
  pinMode(ROW_1, OUTPUT);
  pinMode(ROW_2, OUTPUT);
  pinMode(ROW_3, OUTPUT);

  Serial.begin(115200);

  // ========== Rotary Encoder Setup
  //we must initialize rotary encoder
    rotaryEncoder.begin();
    rotaryEncoder.setup(readEncoderISR);
    //set boundaries and if values should cycle or not
    //in this example we will set possible values between 0 and 1000;
    bool circleValues = false;
    rotaryEncoder.setBoundaries(0, 1000, circleValues); //minValue, maxValue, circleValues true|false (when max go to min and vice versa)

    /*Rotary acceleration introduced 25.2.2021.
   * in case range to select is huge, for example - select a value between 0 and 1000 and we want 785
   * without accelerateion you need long time to get to that number
   * Using acceleration, faster you turn, faster will the value raise.
   * For fine tuning slow down.
   */
    //rotaryEncoder.disableAcceleration(); //acceleration is now enabled by default - disable if you dont need it
    rotaryEncoder.setAcceleration(250); //or set the value - larger number = more accelearation; 0 or 1 means disabled acceleration
  // ========== Rotary Encoder Setup

  if(!display.begin(SSD1306_SWITCHCAPVCC, SCREEN_ADDRESS)) {
    Serial.println(F("SSD1306 allocation failed"));
    for(;;);
  }
  Serial.println("Connected To Serial Port");

  // start BleKeyboard
  bleKeyboard.begin();

  initKeyboardKey();
  
  rotaryEncoder.setEncoderValue(250);

  display.display();
  display.clearDisplay();
  delay(2000);
}

void loop() {
  if(selectedMenu == -1) {
    updateMenuDisplay();
    watchRotary();
  }

  // { KEYBOARD RUN }
  else if(selectedMenu == 0) {
    bleKeyboard.start();
    display.clearDisplay();
    delay(100);

    while(selectedMenu == 0) {
      if (bleKeyboard.isConnected()) {
        display.clearDisplay(); // Clear display buffer
        display.setTextSize(1); // Draw 2X-scale text
        display.setTextColor(SSD1306_WHITE);
        display.setCursor(10, 25);
        display.print("Keyboard connected");
        display.display();
        delay(1500);

        display.clearDisplay();

        while(bleKeyboard.isConnected()) {
          watchKeySwitch();
          watchRotary();
        }

        display.clearDisplay(); // Clear display buffer
        display.setTextSize(1); // Draw 2X-scale text
        display.setTextColor(SSD1306_WHITE);
        display.setCursor(10, 25);
        display.print("Keyboard disconnected");
        display.display();
        delay(1500);

        display.clearDisplay();
      } else {
        waitDisplay();
      }

      if (rotaryEncoder.isEncoderButtonClicked()) {
        bleKeyboard.end();
        rotary_onButtonClick();
      }
    }
  }
  // { KEYBOARD END }

  // { MINI GAMES RUN }
  else if(selectedMenu == 1) {
    updateGameMenuDisplay();
    watchRotary();

    handleRunningRow();
    if(sw_1.isPressed()) {
      selectedMenu = -1;
    }
    while(selectedGame == 0){
      handleRunningRow();
      display.clearDisplay(); // Clear display buffer
      display.setTextSize(1); // Draw 2X-scale text
      display.setTextColor(SSD1306_WHITE);
      display.setCursor(2, 25);
      display.print("Playing Flappy Bird");
      display.display();

      if(sw_1.isPressed()) {
        selectedGame = -1;
      }
    }
  }
  // { MINI GAMES END }

  // { SETTING RUN }
  else if(selectedMenu == 2) {
    updateSettingMenuDisplay();
    watchRotary();

    handleRunningRow();
    if(sw_1.isPressed()) {
      selectedMenu = -1;
    }
  }
  // { SETTING END }
}
